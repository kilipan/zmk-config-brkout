## boards/shields/brk_out/Kconfig.shield
```kconfig
# Copyright (c) 2022 @weteor
# SPDX-License-Identifier: MIT

config SHIELD_BRK_OUT
   def_bool $(shields_list_contains,brk_out)
```

## config/boards/shields/brk_out/Kconfig.defconfig
```kconfig
# Copyright (c) 2022 @weteor
# SPDX-License-Identifier: MIT

if SHIELD_BRK_OUT

config ZMK_KEYBOARD_NAME
    default "BRK OUT"

config I2C
    default y
    
config GPIO_PCA95XX
    default y
    
endif # SHIELD_BRK_OUT
```

## config/boards/shields/brkout/Kconfig.defconfig
```kconfig
# Copyright (c) 2022 @weteor
# SPDX-License-Identifier: MIT

if SHIELD_BRKOUT

config ZMK_KEYBOARD_NAME
    default "BrkOut"

config I2C
    default y
    
config GPIO_PCA95XX
    default y

endif # SHIELD_BRKOUT
```

## config/boards/shields/brkout/Kconfig.shield
```kconfig
# Copyright (c) 2022 @weteor
# SPDX-License-Identifier: MIT

config SHIELD_BRKOUT
   def_bool $(shields_list_contains,brkout)
```
